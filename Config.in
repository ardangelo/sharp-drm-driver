## Config.in
```kconfig
config BR2_PACKAGE_SHARP
	bool "sharp"
	default y
	depends on BR2_LINUX_KERNEL
	select BR2_PACKAGE_LIBDRM
	select BR2_PACKAGE_SPI
	select BR2_PACKAGE_GPIO
	select BR2_PACKAGE_RASPI_GPIO
	help
	  DRM driver for Sharp Memory LCD
```
